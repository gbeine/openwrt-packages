## net/suricata/Config.in
```kconfig
if PACKAGE_suricata

config SURICATA_CUSTOM
	bool "Customize Suricata options"
	default n
        help
          Enabling this allows full customization of Suricata settings.

          Unless you know what you are doing, you should leave this as 'n'

	source "config/Config-defaults.in"

	if SURICATA_CUSTOM
	source "config/Config.in"
	endif

endif
```

## net/suricata/config/Config.in
```kconfig
config SURICATA_NETFILTER
	bool "Build with netfilter"
	default SURICATA_DEFAULT_NETFILTER
	help
	Enable support for netfilter

if SURICATA_NETFILTER
config SURICATA_NETFILTER_LOG
	bool "Build with netfilter-log"
	default SURICATA_DEFAULT_NETFILTER_LOG
	help
	Enable support for netfilter-log

config SURICATA_NETFILTER_QUEUE
	bool "Build with netfilter-queue"
	default SURICATA_DEFAULT_NETFILTER_QUEUE
	help
	Enable support for netfilter-queue
endif

config SURICATA_LIBNET
	bool "Build with libnet"
	default SURICATA_DEFAULT_LIBNET
	help
	Enable support for libnet

config SURICATA_TCMALLOC
	bool "Build with tcmalloc"
	default SURICATA_DEFAULT_TCMALLOC
	help
	Enable support for tcmalloc

if TARGET_x86_64
config SURICATA_HYPERSCAN
	bool "Build with hyperscan"
	default SURICATA_DEFAULT_HYPERSCAN
	help
	Enable support for hyperscan
endif
```
